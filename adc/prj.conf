## CMakeLists.txt
```
# SPDX-License-Identifier: Apache-2.0

cmake_minimum_required(VERSION 3.20.0)

find_package(Zephyr REQUIRED HINTS $ENV{ZEPHYR_BASE})
project(ADC)

target_sources(app PRIVATE src/main.c)



# The external static library that we are linking with does not know
# how to build for this platform so we export all the flags used in
# this zephyr build to the external build system.
#
# Other external build systems may be self-contained enough that they
# do not need any build information from zephyr. Or they may be
# incompatible with certain zephyr options and need them to be
# filtered out.
zephyr_get_include_directories_for_lang_as_string(       C includes)
zephyr_get_system_include_directories_for_lang_as_string(C system_includes)
zephyr_get_compile_definitions_for_lang_as_string(       C definitions)
zephyr_get_compile_options_for_lang_as_string(           C options)

set(external_project_cflags
  "${includes} ${definitions} ${options} ${system_includes}"
  )

include(ExternalProject)

# Add an external project to be able download and build the third
# party library. In this case downloading is not necessary as it has
# been committed to the repository.
set(mylib_src_dir   ${CMAKE_CURRENT_SOURCE_DIR}/mylib)
set(mylib_build_dir ${CMAKE_CURRENT_BINARY_DIR}/mylib)

set(MYLIB_LIB_DIR     ${mylib_build_dir}/lib)
set(MYLIB_INCLUDE_DIR ${mylib_src_dir}/include)

if(CMAKE_GENERATOR STREQUAL "Unix Makefiles")
# https://www.gnu.org/software/make/manual/html_node/MAKE-Variable.html
set(submake "$(MAKE)")
else() # Obviously no MAKEFLAGS. Let's hope a "make" can be found somewhere.
set(submake "make")
endif()

ExternalProject_Add(
  mylib_project                 # Name for custom target
  PREFIX     ${mylib_build_dir} # Root dir for entire project
  SOURCE_DIR ${mylib_src_dir}
  BINARY_DIR ${mylib_src_dir} # This particular build system is invoked from the root
  CONFIGURE_COMMAND ""    # Skip configuring the project, e.g. with autoconf
  BUILD_COMMAND
  ${submake}
  PREFIX=${mylib_build_dir}
  CC=${CMAKE_C_COMPILER}
  AR=${CMAKE_AR}
  CFLAGS=${external_project_cflags}
  INSTALL_COMMAND ""      # This particular build system has no install command
  BUILD_BYPRODUCTS ${MYLIB_LIB_DIR}/libmylib.a
  )

# Create a wrapper CMake library that our app can link with
add_library(mylib_lib STATIC IMPORTED GLOBAL)
add_dependencies(
  mylib_lib
  mylib_project
  )
set_target_properties(mylib_lib PROPERTIES IMPORTED_LOCATION             ${MYLIB_LIB_DIR}/libmylib.a)
set_target_properties(mylib_lib PROPERTIES INTERFACE_INCLUDE_DIRECTORIES ${MYLIB_INCLUDE_DIR})

target_link_libraries(app PUBLIC mylib_lib)


set(lcdlib_src_dir   ${CMAKE_CURRENT_SOURCE_DIR}/lcdlib)
set(lcdlib_build_dir ${CMAKE_CURRENT_BINARY_DIR}/lcdlib)

set(LCDLIB_LIB_DIR     ${mylib_build_dir}/lib)
set(LCDLIB_INCLUDE_DIR ${mylib_src_dir}/include)

ExternalProject_Add(
  lcdlib_project                 # Name for custom target
  PREFIX     ${lcdlib_build_dir} # Root dir for entire project
  SOURCE_DIR ${lcdlib_src_dir}
  BINARY_DIR ${lcdlib_src_dir} # This particular build system is invoked from the root
  CONFIGURE_COMMAND ""    # Skip configuring the project, e.g. with autoconf
  BUILD_COMMAND
  ${submake}
  PREFIX=${lcdlib_build_dir}
  CC=${CMAKE_C_COMPILER}
  AR=${CMAKE_AR}
  CFLAGS=${external_project_cflags}
  INSTALL_COMMAND ""      # This particular build system has no install command
  BUILD_BYPRODUCTS ${LCDLIB_LIB_DIR}/liblcdlib.a
  )

add_library(lcdlib_lib STATIC IMPORTED GLOBAL)
add_dependencies(
  lcdlib_lib
  lcdlib_project
  )
set_target_properties(lcdlib_lib PROPERTIES IMPORTED_LOCATION             ${LCDLIB_LIB_DIR}/liblcdlib.a)
set_target_properties(lcdlib_lib PROPERTIES INTERFACE_INCLUDE_DIRECTORIES ${LCDLIB_INCLUDE_DIR})

target_link_libraries(app PUBLIC lcdlib_lib)
```

## sample.yaml
```
sample:
  name: ADC driver sample
tests:
  sample.drivers.adc:
    tags:
      - adc
    depends_on: adc
    platform_allow:
      - nucleo_l073rz
      - disco_l475_iot1
      - cc3220sf_launchxl
      - cc3235sf_launchxl
      - cy8cproto_063_ble
      - stm32l496g_disco
      - stm32h735g_disco
      - nrf51dk/nrf51822
      - nrf52840dk/nrf52840
      - mec172xevb_assy6906
      - gd32f350r_eval
      - gd32f450i_eval
      - gd32vf103v_eval
      - gd32f403z_eval
      - esp32_devkitc_wroom/esp32/procpu
      - esp32_devkitc_wrover/esp32/procpu
      - esp32s2_saola
      - esp32c3_devkitm
      - gd32l233r_eval
      - lpcxpresso55s36
      - mr_canhubk3
      - longan_nano
      - longan_nano/gd32vf103/lite
    integration_platforms:
      - nucleo_l073rz
      - nrf52840dk/nrf52840
    harness: console
    timeout: 10
    harness_config:
      type: multi_line
      regex:
        - "ADC reading\\[\\d+\\]:"
        - "- .+, channel \\d+: -?\\d+"
```

## prj.conf
```kconfig
CONFIG_ADC=y
CONFIG_STDOUT_CONSOLE=y
# enable to use thread names
CONFIG_THREAD_NAME=y
#CONFIG_SCHED_CPU_MASK=y
CONFIG_SEGGER_SYSTEMVIEW=y
CONFIG_GPIO=y
#CONFIG_TIMESLICING=y
#CONFIG_TIMESLICE_SIZE=100
CONFIG_USE_SEGGER_RTT=y 
CONFIG_TRACING=y
CONFIG_TRACING_BACKEND_RAM=y
CONFIG_TICKLESS_KERNEL=n
CONFIG_TEST_RANDOM_GENERATOR=y
```

## src/main.c
```c
/*
 * Copyright (c) 2020 Libre Solar Technologies GmbH
 *
 * SPDX-License-Identifier: Apache-2.0
 */

#include <inttypes.h>
#include <stddef.h>
#include <stdint.h>

#include <zephyr/device.h>
#include <zephyr/devicetree.h>
#include <zephyr/drivers/adc.h>
#include <zephyr/drivers/gpio.h>
#include <zephyr/kernel.h>
#include <zephyr/sys/printk.h>
#include <zephyr/sys/util.h>
#include <zephyr/random/random.h>
#include <arm_math.h>
#include <stm32f4xx.h>

#define FFT_SAMPLES		512
#define FFT_SIZE		(FFT_SAMPLES / 2)

#define PIN_THREADS (IS_ENABLED(CONFIG_SMP) && IS_ENABLED(CONFIG_SCHED_CPU_MASK))

/* size of stack area used by each thread */
#define STACKSIZE 1024

/* scheduling priority used by each thread */
#define PRIORITY 7
#define PRIORITY5 5

/* delay between greetings (in ms) */
#define SLEEPTIME 1

#if !DT_NODE_EXISTS(DT_PATH(zephyr_user)) || \
	!DT_NODE_HAS_PROP(DT_PATH(zephyr_user), io_channels)
#error "No suitable devicetree overlay specified"
#endif

#define DT_SPEC_AND_COMMA(node_id, prop, idx) \
	ADC_DT_SPEC_GET_BY_IDX(node_id, idx),

/* Data of ADC io-channels specified in devicetree. */
static const struct adc_dt_spec adc_channels[] = {
	DT_FOREACH_PROP_ELEM(DT_PATH(zephyr_user), io_channels,
			     DT_SPEC_AND_COMMA)
};

/* The devicetree node identifier for the "led0" alias. */
#define LED0_NODE DT_ALIAS(led0)
#define FFT_PIN	  DT_ALIAS(pin0)


K_QUEUE_DEFINE(FFT_queue);

struct k_queue FFT_queue;
struct k_msgq FFT_msgq;

static const struct gpio_dt_spec led = GPIO_DT_SPEC_GET(LED0_NODE, gpios);
static const struct gpio_dt_spec pin = GPIO_DT_SPEC_GET(FFT_PIN, gpios);

float32_t FFT_input[FFT_SAMPLES] = {0};
float32_t FFT_output[FFT_SAMPLES];
float32_t freqTable[FFT_SIZE];
float32_t freqOrder[FFT_SIZE];
arm_rfft_fast_instance_f32 FFTHandler;

float32_t baseFreq;

float32_t msgq_buffer;

void FFT_init(float32_t samplingFreq)
{
	for(uint16_t i = 0; i < FFT_SIZE; i++)
	{
		freqOrder[i] = i * samplingFreq / FFT_SAMPLES;
	}

	sys_rand_get(FFT_input, FFT_SAMPLES);
}

void ADC_task_entry(void *dummy1, void *dummy2, void *dummy3)
{
	ARG_UNUSED(dummy1);
	ARG_UNUSED(dummy2);
	ARG_UNUSED(dummy3);

	int err;
	uint32_t count = 0;
	uint16_t buf;
	struct adc_sequence sequence = {
		.buffer = &buf,
		/* buffer size in bytes, not number of samples */
		.buffer_size = sizeof(buf),
	};

	float32_t msgq_rec;

	/* Configure channels individually prior to sampling. */
	for (size_t i = 0U; i < ARRAY_SIZE(adc_channels); i++) {
		if (!adc_is_ready_dt(&adc_channels[i])) {
			printk("ADC controller device %s not ready\n", adc_channels[i].dev->name);
		}

		err = adc_channel_setup_dt(&adc_channels[i]);
		if (err < 0) {
			printk("Could not setup channel #%d (%d)\n", i, err);
		}
	}

	k_queue_init(&FFT_queue);
	k_msgq_init(&FFT_msgq, &msgq_buffer, sizeof(float32_t), 1);

	while(1)
	{
		//k_queue_get(&FFT_queue, K_FOREVER);
		k_msgq_get(&FFT_msgq, &msgq_rec, K_FOREVER);

		// printk("ADC reading[%u]:\n", count++);
		// for (size_t i = 0U; i < ARRAY_SIZE(adc_channels); i++) {
		// 	int32_t val_mv;

		// 	printk("- %s, channel %d: ",
		// 	       adc_channels[i].dev->name,
		// 	       adc_channels[i].channel_id);

		// 	(void)adc_sequence_init_dt(&adc_channels[i], &sequence);

		// 	err = adc_read_dt(&adc_channels[i], &sequence);
		// 	if (err < 0) {
		// 		printk("Could not read (%d)\n", err);
		// 		continue;
		// 	}

		// 	/*
		// 	 * If using differential mode, the 16 bit value
		// 	 * in the ADC sample buffer should be a signed 2's
		// 	 * complement value.
		// 	 */
		// 	if (adc_channels[i].channel_cfg.differential) {
		// 		val_mv = (int32_t)((int16_t)buf);
		// 	} else {
		// 		val_mv = (int32_t)buf;
		// 	}
		// 	printk("%"PRId32, val_mv);
		// 	err = adc_raw_to_millivolts_dt(&adc_channels[i],
		// 				       &val_mv);
		// 	/* conversion to mV may not be supported, skip if not */
		// 	if (err < 0) {
		// 		printk(" (value in mV not available)\n");
		// 	} else {
		// 		printk(" = %"PRId32" mV\n", val_mv);
		// 	}
		// }

	}
}
K_THREAD_DEFINE(ADC_task, STACKSIZE,
				ADC_task_entry, NULL, NULL, NULL,
				PRIORITY5, 0, 0);
extern const k_tid_t ADC_task;

void FFT_task_entry(void *dummy1, void *dummy2, void *dummy3)
{
	ARG_UNUSED(dummy1);
	ARG_UNUSED(dummy2);
	ARG_UNUSED(dummy3);

	int32_t received_from_ADC;
	uint32_t maxFFTValueIndex = 0;
	float32_t maxFFTValue = 0;
	uint16_t freqBufferIndex = 0;
	float32_t f_s = 25000000;

	FFT_init(f_s);
	arm_rfft_fast_init_f32(&FFTHandler, FFT_SAMPLES);

	while(1)
	{
		gpio_pin_set_dt(&pin, 1);
		//SEGGER_SYSVIEW_MarkStart(0);
		arm_rfft_fast_f32(&FFTHandler, FFT_input, FFT_output, 0);
		arm_cmplx_mag_f32(FFT_output, freqTable, FFT_SIZE);
		arm_max_f32(freqTable + 1, FFT_SIZE - 1, &maxFFTValue, &maxFFTValueIndex);

		baseFreq = freqOrder[maxFFTValueIndex];


		//gpio_pin_toggle_dt(&led);
		gpio_pin_set_dt(&pin, 0);
		//SEGGER_SYSVIEW_MarkStop(0);
		//k_queue_append(&FFT_queue, &baseFreq);
		k_msgq_put(&FFT_msgq, &baseFreq, K_FOREVER);
	}
}
K_THREAD_DEFINE(FFT_task, STACKSIZE,
				FFT_task_entry, NULL, NULL, NULL,
				PRIORITY, 0, 0);
extern const k_tid_t FFT_task;

int main(void)
{
	int ret;

	if (!gpio_is_ready_dt(&led)) {
		return 0;
	}

	ret = gpio_pin_configure_dt(&led, GPIO_OUTPUT_ACTIVE);
	if (ret < 0) {
		return 0;
	}

	if (!gpio_is_ready_dt(&pin)) {
		return 0;
	}

	ret = gpio_pin_configure_dt(&pin, GPIO_OUTPUT_ACTIVE);
	if (ret < 0) {
		return 0;
	}

	// k_queue_init(&FFT_queue);

	return 0;
}
```
